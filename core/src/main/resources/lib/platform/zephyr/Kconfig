## core/src/main/resources/lib/platform/zephyr/Kconfig
```kconfig
source "Kconfig.zephyr"

config LF_ZEPHYR_CLOCK_COUNTER
  bool "LF uses the counter API for timing services. Only supported for some boards."
  default n
```
